## main/Kconfig.projbuild
```kconfig
menu "Katana USB MIDI Host"

    config KATANA_USB_VID
        hex "Expected Boss/Roland USB Vendor ID"
        default 0x0582

    config KATANA_USB_PID
        hex "Expected Boss/Roland USB Product ID (Katana models differ)"
        default 0x01D8
        help
            Your unit enumerated as 0x01D8. Other amps may use another PID;
            use menuconfig to match lsusb / Device Manager, or enable
            CONFIG_KATANA_ACCEPT_ANY_ROLAND_PID.

    config KATANA_ACCEPT_ANY_ROLAND_PID
        bool "Accept any Roland (0x0582) PID with a MIDI streaming interface"
        default n

endmenu
```

## sdkconfig.defaults
```kconfig
CONFIG_IDF_TARGET_ESP32S3=y
CONFIG_USB_OTG_SUPPORTED=y
CONFIG_USB_HOST_CONTROL_TRANSFER_MAX_SIZE=512

# Match Boss/Roland device seen on your bus (VID 0582, PID 01D8). Change if needed.
CONFIG_KATANA_USB_PID=0x01D8
```
